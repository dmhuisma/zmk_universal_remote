## firmware/config/west.yml
```yaml
manifest:
  remotes:
    - name: zmkfirmware
      url-base: https://github.com/zmkfirmware
    - name: dmhuisma
      url-base: https://github.com/dmhuisma
    - name: tadakado
      url-base: https://github.com/tadakado
    - name: oleksandrmaslov
      url-base: https://github.com/oleksandrmaslov
  projects:
    - name: zmk
      remote: zmkfirmware
      revision: main
      import: app/west.yml
    - name: zephyr-dt-lvgl
      remote: dmhuisma
      revision: main
      path: modules/lib/zephyr-dt-lvgl
    - name: zmk-ir
      remote: tadakado
      path: modules/lib/zmk-ir
    - name: zmk-pointing-acceleration
      remote: oleksandrmaslov
      path: modules/lib/zmk-pointing-acceleration
  self:
    path: config
```

## firmware/dts/bindings/behaviors/zmk,behavior-bthome-button.yaml
```yaml
description: |
  A key that sends a press to Home Assistant over BTHome (src/bthome.c), the
  same way as a touchscreen button: a tap and a long press are told apart, and
  button-number is the event's step count.

compatible: "zmk,behavior-bthome-button"

include: zero_param.yaml

properties:
  button-number:
    type: int
    required: true
    description: |
      The number Home Assistant sees, 1 to 255. It must not be one that
      bthome-buttons in universal_remote_ui.dtsi already uses.
```

## firmware/dts/bindings/input/universal-remote,motion-pointer.yaml
```yaml
description: |
  Moves the mouse pointer as the remote turns, from the MPU6050's gyroscope
  (src/motion_pointer.c), while the Touchpad screen is shown and its toggle is
  on. The toggle's state is saved, so it stays through sleep and power-off.
  The node is an input device of its own: point a zmk,input-listener at it.

  Turning the remote left and right (yaw) moves the pointer across, and
  tilting it up and down (pitch) moves it up and down. Which gyroscope axes
  those are depends on how the MPU6050 sits in the remote: if the pointer
  moves the wrong way, set invert-x or invert-y, and if tilting moves it
  across, swap the axes.

compatible: "universal-remote,motion-pointer"

properties:
  i2c-bus:
    type: phandle
    required: true
    description: The I2C bus the MPU6050 is on.

  address:
    type: int
    default: 0x68
    description: The MPU6050's I2C address, 0x68 with AD0 low.

  toggle:
    type: phandle
    required: true
    description: A checkable dt-lvgl-button that turns motion on and off.

  toggle-icon:
    type: phandle
    required: true
    description: A label in the toggle whose text is icon-on or icon-off.

  icon-on:
    type: string
    required: true

  icon-off:
    type: string
    required: true

  x-axis:
    type: string
    default: "z"
    enum: ["x", "y", "z"]
    description: The gyroscope axis that moves the pointer across.

  y-axis:
    type: string
    default: "y"
    enum: ["x", "y", "z"]
    description: The gyroscope axis that moves the pointer up and down.

  invert-x:
    type: boolean

  invert-y:
    type: boolean

  pixels-per-degree:
    type: int
    default: 25
    description: How far the pointer moves for each degree the remote turns.

  deadzone-mdps:
    type: int
    default: 1000
    description: |
      Turning slower than this, in thousandths of a degree per second, does
      not move the pointer, so a hand's tremor holds it still. Faster turns
      have this much taken off.

  sample-period-ms:
    type: int
    default: 10
    description: How often the gyroscope is read.

  touch-holdoff-ms:
    type: int
    default: 150
    description: |
      How long after a finger lifts from the pad turning the remote moves the
      pointer again. It ignores turning while a finger is on the pad too.
```

## firmware/dts/bindings/input/universal-remote,touchpad.yaml
```yaml
description: |
  Turns touches on one dt-lvgl screen into relative mouse input, so the touch
  screen works as a touchpad (src/touchpad.c). The node is an input device of
  its own: point a zmk,input-listener at it.

  A touch counts only if it starts inside the area widget while the screen is
  shown. Dragging reports INPUT_REL_X and INPUT_REL_Y, a quick tap clicks
  INPUT_BTN_0, and holding still clicks INPUT_BTN_1.

compatible: "universal-remote,touchpad"

properties:
  touch-device:
    type: phandle
    required: true
    description: The touch controller, which reports INPUT_ABS_X, INPUT_ABS_Y and INPUT_BTN_TOUCH.

  screen:
    type: phandle
    required: true
    description: The dt-lvgl-screen the touchpad is on.

  area:
    type: phandle
    required: true
    description: The dt-lvgl widget a touch has to start on.

  layer:
    type: int
    description: |
      A keymap layer that is on while the screen is shown and off otherwise,
      for keys that act differently there.

  tap-timeout-ms:
    type: int
    default: 180
    description: A touch lifted within this long, without moving, is a left click.

  tap-slop-px:
    type: int
    default: 6
    description: |
      How far a touch can travel, in panel pixels, and still be a tap or a long
      press. Nothing moves until it goes further, so a tap does not nudge the
      pointer.

  long-press-ms:
    type: int
    default: 500
    description: A touch held this long without moving is a right click.
```
